## boards/shields/ambi/Kconfig.defconfig
```kconfig
# Copyright (c) 2025 The ZMK Contributors
# SPDX-License-Identifier: MIT

if SHIELD_AMBI

config ZMK_KEYBOARD_NAME
    default "Ambi"

endif
```

## boards/shields/ambi/Kconfig.shield
```kconfig
# Copyright (c) 2025 The ZMK Contributors
# SPDX-License-Identifier: MIT

config SHIELD_AMBI
    def_bool $(shields_list_contains,ambi)
```
